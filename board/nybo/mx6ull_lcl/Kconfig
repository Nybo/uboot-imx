## board/nybo/mx6ull_lcl/Kconfig
```kconfig
if TARGET_MX6ULL_LCL

config SYS_BOARD
	default "mx6ull_lcl"

config SYS_VENDOR
	default "nybo"

config SYS_CONFIG_NAME
	default "mx6ull_lcl"

config SYS_TEXT_BASE
	default 0x87800000
endif
```

## board/nybo/pepper/Kconfig
```kconfig
if TARGET_MX6ULL_PEPPER

config SYS_BOARD
	default "mx6ull_pepper"

config SYS_VENDOR
	default "nybo"

config SYS_CONFIG_NAME
	default "mx6ull_pepper"

config SYS_TEXT_BASE
	default 0x87800000
endif
```
